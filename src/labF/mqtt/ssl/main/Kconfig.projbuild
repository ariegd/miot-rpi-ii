## src/labF/mqtt/ssl/main/Kconfig.projbuild
```kconfig
menu "Example Configuration"

    config BROKER_URI
        string "Broker URL"
        default "mqtts://test.mosquitto.org:8883"
        help
            URL of an mqtt broker which this example connects to.

   config CERT_SOURCE_HARDCODED
        bool "Usar Certificado Mosquitto (Fijo en Código)"
        default n
        help
            Si se marca, usa el certificado de mosquitto.org definido manualmente en app_main.c.
            Si se desmarca, el código intentará usar el archivo .pem externo.

    config BROKER_CERTIFICATE_OVERRIDE
        string "Broker certificate override"
        default ""
        help
            Please leave empty if broker certificate included from a textfile; otherwise fill in a base64 part of PEM
            format certificate

    config BROKER_CERTIFICATE_OVERRIDDEN
        bool
        default y if BROKER_CERTIFICATE_OVERRIDE != ""

    config BROKER_BIN_SIZE_TO_SEND
        # This option is not visible and is used only to set parameters for example tests
        # Here we configure the data size to send and to be expected in the python script
        int
        default 20000

endmenu
```

## src/labF/rssi_thingsboard/components/mqtts_comp/Kconfig.projbuild
```kconfig
menu "MQTTS Configuration"

   choice BROKER_SELECTION
        prompt "Select MQTT Broker Destination"
        default BROKER_THINGSBOARD
        help
            Elija el servidor preconfigurado o una dirección personalizada. 

        config BROKER_MOSQUITTO
            bool "Mosquitto Test (test.mosquitto.org)"

        config BROKER_THINGSBOARD
            bool "ThingsBoard Demo (eu.thingsboard.cloud)"

        config BROKER_CUSTOM_IP
            bool "Dirección IP Local / Personalizada"
    endchoice
                
     config TB_PROVISION_KEY
          string "ThingsBoard Provision Device Key"
          default "PUT_YOUR_KEY_HERE"
          depends on BROKER_THINGSBOARD 
          help
              Key obtenida en Device Profiles -> Tu Perfil -> Device Provisioning.

     config TB_PROVISION_SECRET
         string "ThingsBoard Provision Device Secret"
         default "PUT_YOUR_SECRET_HERE"
         depends on BROKER_THINGSBOARD 
         help
             Secret obtenido en Device Profiles -> Tu Perfil -> Device Provisioning.
        
     config BROKER_URI
         string "Broker URL"
         depends on BROKER_CUSTOM_IP
         default "mqtts://10.174.33.72:8883"
         help
             URL of an mqtt broker which this example connects to. [cite: 2, 7]

    # Estas variables se mantienen ocultas pero calculan el valor para el código C
    config BROKER_URI_INTERNAL
        string
        default "mqtts://demo.thingsboard.io:8883" if BROKER_THINGSBOARD
        default "mqtts://test.mosquitto.org:8883" if BROKER_MOSQUITTO
        default BROKER_URI if BROKER_CUSTOM_IP

    config BROKER_CERTIFICATE_OVERRIDE
        string "Broker certificate override"
        default ""
        help
            Please leave empty if broker certificate included from a textfile; otherwise fill in a base64 part of PEM
            format certificate

    config BROKER_CERTIFICATE_OVERRIDDEN
        bool
        default y if BROKER_CERTIFICATE_OVERRIDE != ""

    config BROKER_BIN_SIZE_TO_SEND
        # This option is not visible and is used only to set parameters for example tests
        # Here we configure the data size to send and to be expected in the python script
        int
        default 20000

endmenu
```
